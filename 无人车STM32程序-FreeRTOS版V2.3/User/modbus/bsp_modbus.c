#include "./modbus/bsp_modbus.h"

 /** 地址转换程序
 * 由于机械臂当写在序号GV开头的全局变量时，使用的是32位的大端。所以需要转换
 * 参数：全局变量地址
 * 返回值：机械臂上的地址
 */

/*******************************************************************************************/
/*******************************************************************************************/
 /** 数据转换程序
 * 函数：Float2Hex
 * 由于机械臂当写在序号GV开头的全局变量时，使用的是32位的大端。所以需要转换
 * 参数：要写入全局变量中的十进制值
 * 返回值：要写入全局变量中的16进制值
 */
uint32_t data2hex(int16_t data)  
{
	uint32_t temp;  
	uint8_t i=0;
	char flag = 0;//正负标志位，正0，负1

	if(data < 0)
	{
		flag = 1;
		data = ~data+1;//变回正数先
	}
	else if(data==0)
	{
		return (uint32_t)0;
	}
	temp = (uint32_t)data;//转存需要计算的数值  
	while(temp)  
	{         
		temp >>= 1;  
		i++;//计算当前值的尾数占有的位数  
	}  
	i--;//计算下来，i会多加一次，这儿减掉  相当于阶码，阶次
	data = data & (~((uint32_t)1 << i));//清除最高位的1
	temp = data;  //再次赋值，准备合并
	temp = temp<<(23-i);//补足23位尾数  
	temp = (i+127)<<23 | temp;//计算指数，并与尾数合并起来
	
	if(flag == 1)
	{
		temp = temp | (((uint32_t)1<<31));//确定负数
	}
	else
	{
		temp = temp & (~((uint32_t)1<<31));//确定正数
	}  

	return temp;//这里就已经是以浮点数的存储方式表示的传进来的参数了
}

/*******************************************************************************************/
/*******************************************************************************************/

/* 高字节CRC表 */ 
const uint8_t auchCRCHi[] = 
{
      0x00, 0xC1, 0x81, 0x40, 0x01, 0xC0, 0x80, 0x41, 0x01, 0xC0, 
      0x80, 0x41, 0x00, 0xC1, 0x81, 0x40, 0x01, 0xC0, 0x80, 0x41, 
      0x00, 0xC1, 0x81, 0x40, 0x00, 0xC1, 0x81, 0x40, 0x01, 0xC0, 
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      0x80, 0x41, 0x00, 0xC1, 0x81, 0x40
} ; 
 
/* 低字节CRC表 */
const uint8_t auchCRCLo[] = 
{
      0x00, 0xC0, 0xC1, 0x01, 0xC3, 0x03, 0x02, 0xC2, 0xC6, 0x06, 
      0x07, 0xC7, 0x05, 0xC5, 0xC4, 0x04, 0xCC, 0x0C, 0x0D, 0xCD, 
      0x0F, 0xCF, 0xCE, 0x0E, 0x0A, 0xCA, 0xCB, 0x0B, 0xC9, 0x09, 
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      0x43, 0x83, 0x41, 0x81, 0x80, 0x40
} ;



/* 参  数：
 * puchMsg  ―― const BYTE*，指向待校验数据存储区的首地址
 * usDataLen ―― 待校验数据的字节个数
 * 返回值：WORD型，计算出的CRC值。   */
uint16_t CalCrcFast(const uint8_t* puchMsg , uint16_t usDataLen)
{
        uint8_t uchCRCHi = 0xFF ;  /* CRC高字节初始化 */
        uint8_t uchCRCLo = 0xFF ;  /* CRC低字节初始化 */
        uint16_t uIndex;           /* CRC查表的索引*/
                   
        while (usDataLen--)             
        {
                  uIndex = uchCRCHi ^ *puchMsg++ ;       /* 计算 CRC */
                  uchCRCHi = uchCRCLo ^ auchCRCHi[uIndex];
                  uchCRCLo = auchCRCLo[uIndex] ;
        }
        return (uchCRCHi << 8 | uchCRCLo) ; 
}


 /**
	* @brief  需要通过modbus发送给机械臂的数据
	* @param  id-站号 fun-功能码  address-地址  data-数据
  * @retval 返回数据指针
	* 暂时只支持0x05写单线圈和0x06写保持寄存器
  */
static uint8_t* Send_Data_modbus(uint8_t id,uint8_t fun,uint16_t address,uint16_t data)
{
	static uint8_t send_buff[8];//原来是8  总共8个字节
	uint16_t crc = 0;
	send_buff[0] = id;
	send_buff[1] = fun;
	send_buff[2] = (address>>8)&0xff; //取高位
	send_buff[3] = address & 0xff;  //取低位
	send_buff[4] = (data>>8)&0xff;  //取高位
	send_buff[5] = data & 0xff;  //取低位
	
	
	if(fun == 0x05)//写单线圈
	{
		
		if(data > 0)
		{
			send_buff[4] = 0xFF;  
			send_buff[5] = 0x00;  
		}
		else if(data <= 0)
		{
			send_buff[4] = 0x00;  
			send_buff[5] = 0x00; 
		}
	}
	
	
	crc = CalCrcFast(send_buff,6);//CRC16校验
	send_buff[6] = (crc>>8)&0xff; //取高位
	send_buff[7] = crc&0xff; //取低位
	
	return send_buff;
}
/**
* @brief  发送数据给机械臂
	* @param  id-站号  fun-功能码 address-地址  data-数据
  * @retval 无
	* 暂时只支持0x05写单线圈和0x06写保持寄存器
  */
 void Send_Msg_toRobot(uint8_t id,uint8_t fun,uint16_t address,uint16_t data)
{
	uint8_t* str = NULL;
	str = Send_Data_modbus( id, fun, address, data);
	Usart_SendStr_length(CAMERA_USART,str,8);
	Usart_SendStr_length(SCREEN_USART,str,8);
	
}


/**
* @brief  发送数据给机械臂线圈--即功能码0x05
	* @param  id-站号 fun-功能码  address-地址  data-数据
  * @retval 无
	* 暂时只支持0x05写单线圈和0x06写保持寄存器
  */
void Send_Msg_toRobot_Coil(uint16_t address,uint16_t data)
{
	uint8_t* str = NULL;
	str = Send_Data_modbus( MODBUS_ID, 0x05, address, data);
	Usart_SendStr_length(CAMERA_USART,str,8);
	Usart_SendStr_length(SCREEN_USART,str,8);
	printf("发送数据：\r\n");
	printf("ID：%#x\r\n",MODBUS_ID);
	printf("功能码：%#x\r\n",0x05);
	printf("地址：%#x\r\n",address);
	printf("数据：%#x\r\n",data);
	printf("CRCH：%#x\r\n",str[6]);
	printf("CRCL：%#x\r\n\r\n",str[7]);
	delay_ms(10);
}

/**
* @brief  发送数据给机械臂全局变量（保持寄存器）--即功能码0x06
	* @param  id-站号   address-地址  data-数据
  * @retval 无
	* 暂时只支持0x05写单线圈和0x06写保持寄存器
  */
void Send_Msg_toRobot_HoldReg(uint16_t address,int16_t data)
{
	uint8_t* str = NULL;
	uint32_t Data;
	uint16_t data_L=0;
	uint16_t data_H=0;
	uint16_t address_L;
	uint16_t address_H;
//	Data = float2Hex((float)data);
	Data = data2hex(data);//转换成IEEE754格式
	data_L = (uint16_t)(Data&(0x0000FFFF));
	data_H = (uint16_t)(Data>>16);
	address_L = address*2;
	address_H = address*2+1;
	
	printf("data:%#x\r\n",data);
	printf("Data:%#x\r\n",Data);
	
	str = Send_Data_modbus( MODBUS_ID, 0x06, address_L, data_L);
	printf("str:%#x ",str[0]);
	printf("%#x ",str[1]);
	printf("%#x ",str[2]);
	printf("%#x ",str[3]);
	printf("%#x ",str[4]);
	printf("%#x ",str[5]);
	printf("%#x ",str[6]);
	printf("%#x\r\n\r\n",str[7]);
	Usart_SendStr_length(CAMERA_USART,str,8);
	Usart_SendStr_length(SCREEN_USART,str,8);
//	printf("发送数据：\r\n");
//	printf("ID：%#x\r\n",MODBUS_ID);
//	printf("功能码：%#x\r\n",0x06);
//	printf("地址：%#x  GV:%d\r\n",address_L,address);
//	printf("数据L：%#x\r\n",data_L);
//	printf("CRCH：%#x\r\n",str[6]);
//	printf("CRCL：%#x\r\n\r\n",str[7]);
//	
	str = Send_Data_modbus( MODBUS_ID, 0x06, address_H, data_H);
	printf("str:%#x ",str[0]);
	printf("%#x ",str[1]);
	printf("%#x ",str[2]);
	printf("%#x ",str[3]);
	printf("%#x ",str[4]);
	printf("%#x ",str[5]);
	printf("%#x ",str[6]);
	printf("%#x\r\n\r\n",str[7]);
	Usart_SendStr_length(CAMERA_USART,str,8);
	Usart_SendStr_length(SCREEN_USART,str,8);
	
//	printf("发送数据：\r\n");
//	printf("ID：%#x\r\n",MODBUS_ID);
//	printf("功能码：%#x\r\n",0x06);
//	printf("地址：%#x  GV:%d\r\n",address_H,address);
//	printf("数据H：%#x\r\n",data_H);
//	printf("CRCH：%#x\r\n",str[6]);
//	printf("CRCL：%#x\r\n\r\n",str[7]);
	delay_ms(10);
	
}


